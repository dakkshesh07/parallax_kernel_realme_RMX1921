// SPDX-License-Identifier: GPL-2.0
// Copyright (c) 2021, Divyanshu-Modi <divyan.m05@gmail.com>
// Copyright (c) 2021, Dakkshesh07 <dakkshesh5@gmail.com>
// Copyright (c) 2021, The Linux Foundation. All rights reserved.

/* RMX 1921 specific changes */

&soc {
	qcom,msm-adsp-loader {
		adsp-firmware = "adsp_v2";
	};
};