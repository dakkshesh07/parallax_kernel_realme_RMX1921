## Kconfig
```kconfig
#
# For a description of the syntax of this configuration file,
# see Documentation/kbuild/kconfig-language.txt.
#
mainmenu "Linux/$(ARCH) $(KERNELVERSION) Kernel Configuration"

source "scripts/Kconfig.include"

source "arch/$(SRCARCH)/Kconfig"
```

## drivers/input/oplus_fp/Kconfig
```kconfig
menuconfig OPPO_FINGERPRINT
	bool "OPLUS fingerprint"
	depends on SPI_MASTER
	help
	  Say Y here to enable OPLUS fingerprint support

if OPPO_FINGERPRINT
### platform config
config OPPO_FINGERPRINT_QCOM
       default n
       tristate "Fingerprint base on QCOM"

### fingerprint sensor config

config OPPO_FINGERPRINT_GOODIX_OPTICAL
       default n
       tristate "Fingerprint base on goodix optical chip"

### fingerprint feature config
config OPPO_FINGERPRINT_NAVIGATION_ENABLE
       default n
       tristate "Fingerprint navigation function"

endif #OPPO_FINGERPRINT
```

## drivers/input/oppo_fp/Kconfig
```kconfig
config OPPO_FINGERPRINT
       tristate "OPPO fingerprint devices"
       depends on SPI_MASTER
       help
         Say Y here to enable OPPO fingerprint driver support

config OPPO_FINGERPRINT_QCOM
       default y
       tristate "Fingerprint base on QCOM"

config OPPO_FINGERPRINT_MTK
       default n
       tristate "Fingerprint base on MTK"

config OPPO_FINGERPRINT_CHIP
       default 1245
       tristate "Fingerprint chip"

source "drivers/input/oppo_fp/oppo_fp_common/Kconfig"
source "drivers/input/oppo_fp/fpc/Kconfig"
source "drivers/input/oppo_fp/goodix_optical_fp/Kconfig"
```

## drivers/input/oppo_fp/fpc/Kconfig
```kconfig
config OPPO_FINGERPRINT_FPC
	tristate "FPC fingerprint sensor"
	select OPPO_FINGERPRINT_QCOM
	depends on OPPO_FINGERPRINT_COMMON
	help
	  Say Y here to enable support for FPC fingerprint sensor.

	  If unsure, say N.

	  To compile this driver as a module, choose M here.
```

## drivers/input/oppo_fp/goodix_optical_fp/Kconfig
```kconfig
config OPPO_FINGERPRINT_GOODIX
	tristate "Goodix fingerprint sensor"
	select OPPO_FINGERPRINT_QCOM
	depends on OPPO_FINGERPRINT_COMMON
	help
	  Say Y here to enable support for Goodix fingerprint sensor.

	  If unsure, say N.

	  To compile this driver as a module, choose M here.

choice
	prompt "Goodix fingerprint sensor bus support"
	depends on OPPO_FINGERPRINT_GOODIX
	default FINGERPRINT_GOODIX_FP_PLATFORM

config OPPO_FINGERPRINT_GOODIX_SPI
	bool "SPI bus support"
	depends on OPPO_FINGERPRINT_GOODIX && SPI
	help
	  Say Y here if you want to enable support for Goodix fingerprint
	  sensor through SPI bus.

config OPPO_FINGERPRINT_GOODIX_PLATFORM
	bool "Platform bus support"
	depends on OPPO_FINGERPRINT_GOODIX
	help
	  Say Y here if you want to enable support for Goodix fingerprint
	  sensor through platform bus.

endchoice

config OPPO_FINGERPRINT_GOODIX_NETLINK
	bool "Goodix fingerprint sensor netlink notification support"
	depends on OPPO_FINGERPRINT_GOODIX
	help
	  Say Y here if you want to enable notification support through
	  netlink in Goodix fingerprint sensor driver.

config OPPO_FINGERPRINT_GOODIX_CLK_CTRL
	bool "Goodix fingerprint sensor SPI clock control"
	depends on OPPO_FINGERPRINT_GOODIX_SPI
	help
	  Say Y here if you want to enable SPI clock control support
	  in Goodix fingerprint sensor driver.

config OPPO_FINGERPRINT_GOODIX_NAV_EVENT
	bool "Goodix fingerprint sensor navigation events"
	depends on OPPO_FINGERPRINT_GOODIX
	help
	  Say Y here if you want to enable support for navigation events
	  in Goodix fingerprint sensor driver
```

## drivers/input/oppo_fp/oppo_fp_common/Kconfig
```kconfig
config OPPO_FINGERPRINT_COMMON
	tristate "OPPO common fingerprint driver"
	select OPPO_FINGERPRINT_QCOM
	depends on OPPO_FINGERPRINT
	help
	  Say Y here if you wanna compile OPPO common fingerprint drivers.

	  If unsure, say N.

	  To compile this driver as a module, choose M here.
```

## drivers/platform/realme/Kconfig
```kconfig
#------------------------------#
# Realme configuration options #
#------------------------------#

menu "Realme board selection"

config MACH_REALME
	bool "Support for Realme device"
	depends on ARCH_QCOM
	help
	  Support for Realme Products.

config MACH_REALME_RMX1921
        bool "Support for Realme XT RMX1921"
        depends on MACH_REALME
        help
          Support for Realme XT RMX1921.

config MACH_REALME_RMX1971
        bool "Support for Realme 5 Pro RMX1971"
        depends on MACH_REALME
        help
          Support for Realme 5 Pro RMX1971.
 
endmenu
```

## drivers/soc/oppo/oppo_devinfo/Kconfig
```kconfig
# ifdef CONFIG_REALME_RETARD 
# yixue.ge add for config oppo software devinfo soft
      config OPPO_DEVICE_IFNO
      bool "config oppo devinfo software"
	  help
		define this config to compile devinfo.c for device register
#endif /* CONFIG_REALME_RETARD */
```
